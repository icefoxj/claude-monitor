## components/monitor-core/Kconfig
```kconfig
menu "claude-monitor"

    config MONITOR_ANIME_THEME
        bool "Anime theme (orange NERV-style HUD with Japanese captions)"
        default n
        help
            Embeds the fonts of the "anime" theme (fonts/cond*, mono*,
            gothic*, mincho*.vlw, about 900 KB of flash) so that "theme anime"
            can switch the views to it. Meant for large panels (the Tab5); the
            drawing code is always built, only the fonts depend on this.

    config MONITOR_LCARS_THEME
        bool "LCARS theme (pastel elbows and capsules of 90s TV starship consoles)"
        default n
        help
            Embeds the fonts of the "lcars" theme (fonts/lcars*.vlw) so that
            "theme lcars" can switch the views to it. Meant for large panels
            (the Tab5); the drawing code is always built, only the fonts
            depend on this.

    config MONITOR_GALACTIC_THEME
        bool "Galactic theme (vector targeting computers of 70s space-opera films)"
        default n
        help
            Embeds the fonts of the "galactic" theme (fonts/gal*.vlw) so that
            "theme galactic" can switch the views to it. Meant for large panels
            (the Tab5); the drawing code is always built, only the fonts
            depend on this.

    config MONITOR_MECH_THEME
        bool "Mech theme (the house look of the other projects' apps and HUDs)"
        default n
        help
            Lets "theme mech" switch the views to the house mech look:
            outlined panels with 45-degree cuts on black, a yellow livery, hazard
            stripes and a chamfered stroke font. Its text is drawn as
            strokes, so this embeds nothing; hook data uses the anime
            theme's monospace font when that theme is on, DejaVu otherwise.
            Meant for large panels (the Tab5).

endmenu
```
