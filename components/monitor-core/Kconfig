## components/monitor-core/Kconfig
```kconfig
menu "claude-monitor"

    config MONITOR_ANIME_THEME
        bool "Anime theme (orange NERV-style HUD with Japanese captions)"
        default n
        help
            Embeds the fonts of the "anime" theme (fonts/cond*, mono*,
            gothic*, mincho*.vlw, about 900 KB of flash) so that "theme anime"
            can switch the views to it. Meant for large panels (the Tab5); the
            drawing code is always built, only the fonts depend on this.

    config MONITOR_LCARS_THEME
        bool "LCARS theme (pastel elbows and capsules of 90s TV starship consoles)"
        default n
        help
            Embeds the fonts of the "lcars" theme (fonts/lcars*.vlw) so that
            "theme lcars" can switch the views to it. Meant for large panels
            (the Tab5); the drawing code is always built, only the fonts
            depend on this.

    config MONITOR_GALACTIC_THEME
        bool "Galactic theme (vector targeting computers of 70s space-opera films)"
        default n
        help
            Embeds the fonts of the "galactic" theme (fonts/gal*.vlw) so that
            "theme galactic" can switch the views to it. Meant for large panels
            (the Tab5); the drawing code is always built, only the fonts
            depend on this.

endmenu
```
